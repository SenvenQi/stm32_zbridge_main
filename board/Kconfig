## board/Kconfig
```kconfig
menu "Hardware Drivers Config"

config SOC_STM32F103RB
    bool
    select SOC_SERIES_STM32F1
    select RT_USING_COMPONENTS_INIT
    select RT_USING_USER_MAIN
    default y

menu "Onboard Peripheral Drivers"

endmenu

menu "On-chip Peripheral Drivers"

    config BSP_USING_GPIO
        bool "Enable GPIO"
        select RT_USING_PIN
        default y

     config BSP_USING_ON_CHIP_FLASH
            bool "Enable on-chip FLASH"
            default n

     menuconfig BSP_USING_TIM
         bool "Enable timer"
         default n
         select RT_USING_HWTIMER
         if BSP_USING_TIM
            config BSP_USING_TIM2
                bool "Enable TIM2"
                default n
         endif
     menuconfig BSP_USING_PWM
           bool "Enable PWM"
           default n
           select RT_USING_PWM
           if BSP_USING_PWM
           menuconfig BSP_USING_PWM2
               bool "Enable timer2 output PWM"
               default n
               if BSP_USING_PWM2
                   config BSP_USING_PWM3_CH1
                       bool "Enable PWM3 channel1"
                       default n

                   config BSP_USING_PWM2_CH2
                       bool "Enable PWM2 channel2"
                       default n

                   config BSP_USING_PWM2_CH3
                       bool "Enable PWM2 channel3"
                       default n
               endif
           endif

    menuconfig BSP_USING_CAN
        bool "Enable CAN"
        select RT_USING_CAN
        default n
        if BSP_USING_CAN
            config BSP_USING_CAN1
                bool "Enable CAN1"
                default y
        endif
   menuconfig BSP_USING_SPI
        bool "Enable SPI BUS"
        default n
        select RT_USING_SPI
        if BSP_USING_SPI
            config BSP_USING_SPI1
                bool "Enable SPI1 BUS"
                default n

            config BSP_SPI1_TX_USING_DMA
                bool "Enable SPI1 TX DMA"
                depends on BSP_USING_SPI1
                default n

            config BSP_SPI1_RX_USING_DMA
                bool "Enable SPI1 RX DMA"
                depends on BSP_USING_SPI1
                select BSP_SPI1_TX_USING_DMA
                default n

        endif
        if BSP_USING_SPI
                    config BSP_USING_SPI2
                        bool "Enable SPI1 BUS"
                        default n

                    config BSP_SPI1_TX_USING_DMA
                        bool "Enable SPI2 TX DMA"
                        depends on BSP_USING_SPI1
                        default n

                    config BSP_SPI1_RX_USING_DMA
                        bool "Enable SPI2 RX DMA"
                        depends on BSP_USING_SPI1
                        select BSP_SPI2_TX_USING_DMA
                        default n

                endif
    menuconfig BSP_USING_UART
        bool "Enable UART"
        default y
        select RT_USING_SERIAL
        if BSP_USING_UART
            config BSP_USING_UART1
                bool "Enable UART1"
                default y

            config BSP_UART1_RX_USING_DMA
                bool "Enable UART1 RX DMA"
                depends on BSP_USING_UART1 && RT_SERIAL_USING_DMA
                default n

            config BSP_UART1_RX_BUFSIZE
                 int "Set UART1 RX buffer size"
                 range 64 65535
                 depends on RT_USING_SERIAL_V2
                 default 256

            config BSP_UART1_TX_BUFSIZE
                  int "Set UART1 TX buffer size"
                  range 0 65535
                  depends on RT_USING_SERIAL_V2
                  default 0

             config BSP_USING_UART2
                bool "Enable UART2"
                default y

             config BSP_UART1_RX_USING_DMA
                 bool "Enable UART2 RX DMA"
                 depends on BSP_USING_UART2 && RT_SERIAL_USING_DMA
                 default n


            config BSP_UART2_RX_BUFSIZE
                 int "Set UART1 RX buffer size"
                 range 64 65535
                 depends on RT_USING_SERIAL_V2
                 default 256

            config BSP_UART2_TX_BUFSIZE
                  int "Set UART1 TX buffer size"
                  range 0 65535
                  depends on RT_USING_SERIAL_V2
                  default 0
        endif

    source "libraries/HAL_Drivers/Kconfig"
       
endmenu

menu "Board extended module Drivers"

endmenu

endmenu
```
